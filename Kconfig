## Kconfig
```kconfig
mainmenu "Example project Configuration"

source "buildsystem/Kconfig"

config PLACEHOLDER_FOR_STATIC_STUFF_UWU
  def_bool y
  select BUILD_HAS_EXECUTABLE
  #select BUILD_IS_LIBRARY
  #select BUILD_IS_KERNEL

menu General
  config VERSION_MAJOR
    int
    default 0

  config VERSION_MINOR
    int
    default 1

  config VERSION_PATCH
    int
    default 0

  config VERSION_LOCAL_VERSION
    string "Local version"
    default ""
    help
      Appended to the end of version string
  
  config STRICTLY_POSIX
    bool "Strict POSIX compliant"
    default y
    help
      Disable any non POSIX 2008 libc or
      platform specific API usage
endmenu

menu "Fun"
  config COMPILE_UWUIFY_UTIL
    bool
  
  config UWUIFY
    bool "Enable UwU-ify"
    default n
    select COMPILE_UWUIFY_UTIL
    help
      This does nothing other than showing showing UwU-ify related options
      for fun
      Thiz doez nyothing othew than showing UwU-ify wewated options
      fow f-fuwun 
  
  config FUN_TEXT_TRANSFORMATION
    def_bool n
  
  config UWUIFY_LOG_FORMAT
    bool "UwU-ify log formats"
    default n
    depends on UWUIFY
    depends on !UWUIFY_LOG_FORCE
    help
      This has effect of UwU-ing all logs made by program
      Thiz has effect of UwU-ing aww wogs made by pwogwam

  config UWUIFY_THREAD_NAME
    bool "UwU-ify thread names"
    default n
    depends on UWUIFY
    select FUN_TEXT_TRANSFORMATION
    help
      This has effect of UwU-ing all thread names
      Thiz has effect of UwU-ing aww t-thwead nyames

  config UWUIFY_LOG_FORCE
    bool "Force UwU-ify on log buffer"
    default n
    depends on UWUIFY
    select UWUIFY_THREAD_NAME
    select FUN_TEXT_TRANSFORMATION
    help
      This has effect of UwU-ing practically everything that logging subsystem
      writes to circular buffer (actually this UwU-ify happen right before writing)
      Thiz has effect of U-UwU-ing pwacticawwy evewything that wogging subsystem
      wwitez t-to ciwcuwaw buffew (actuawwy this UwU-ify h-happen wight befowe wwiting)
endmenu

config DONT_START_SEPERATE_MAIN_THREAD
  bool "Don't start seperate main thread"
  default n
```
